## config/boards/shields/event0/Kconfig.defconfig
```kconfig
if SHIELD_EVENT0_LEFT

config ZMK_SPLIT_BLE_ROLE_CENTRAL
	default y

endif

if SHIELD_EVENT0_LEFT || SHIELD_EVENT0_RIGHT

config ZMK_KEYBOARD_NAME
	default "event0 keyboard"

config ZMK_SPLIT
	default y

endif
```

## config/boards/shields/event0/Kconfig.shield
```kconfig
config SHIELD_EVENT0_LEFT
    def_bool $(shields_list_contains,event0_left)

config SHIELD_EVENT0_RIGHT
    def_bool $(shields_list_contains,event0_right)
```
